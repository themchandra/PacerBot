/**
 * @file packet_info.cpp
 * @brief Contains relevant information about UART data packets
 * @author Hayden Mai
 * @date Nov-02-2025
 */

#include "comm/uart/config.h"
#include "comm/uart/packet_info.h"

#include <iostream>
#include <string.h>

namespace uart {
    DataPacket::DataPacket(ePacketID id, std::span<const uint8_t> data_payload)
        : sync_(SYNC_RECV),
          id_(id),
          data_(data_payload.begin(), data_payload.end())
    {
        crc8_ = calculate_crc8();
    }


    DataPacket::DataPacket(uint8_t sync, ePacketID id,
                           std::vector<uint8_t> data_payload, uint8_t crc8)
        : sync_(sync),
          id_(id),
          data_(std::move(data_payload)),
          crc8_(crc8)
    {}


    size_t DataPacket::serialize(uint8_t *buf, size_t buf_size) const
    {
        size_t packet_size {sizeof(DataPacket_raw) + data_.size() + 1};
        if (buf_size < packet_size) {
            return 0;
        }

        DataPacket_raw *raw_ptr = reinterpret_cast<DataPacket_raw *>(buf);
        raw_ptr->sync           = sync_;
        raw_ptr->id             = id_;
        raw_ptr->length         = static_cast<uint8_t>(data_.size());
        memcpy(raw_ptr->data, data_.data(), data_.size());
        raw_ptr->data[raw_ptr->length] = crc8_;

        return packet_size;
    }


    std::optional<DataPacket> DataPacket::deserialize(const uint8_t *rawData,
                                                      size_t length)
    {
        if (!rawData || length > sizeof(DataPacket_raw) || length == 0) {
            std::cout << "Invalid packet\n";
            return std::nullopt;
        }

        // Reinterpret bytes as a DataPacket_raw struct
        const DataPacket_raw *raw_ptr = reinterpret_cast<const DataPacket_raw *>(rawData);

        // Validate sync byte
        if (raw_ptr->sync != 0x5A && raw_ptr->sync != 0xA5) {
            std::cout << "Invalid sync byte\n";
            return std::nullopt;
        }

        // Check raw packet length, +1 for crc8
        size_t expected_length {raw_ptr->totalSize()};
        if (length < expected_length) {
            std::cout << "Invalid length\n";
            return std::nullopt;
        }

        // Extract data
        std::vector<uint8_t> data(raw_ptr->data, raw_ptr->data + raw_ptr->length);
        uint8_t raw_crc8 {raw_ptr->data[raw_ptr->length]};

        // Store data & validate checksum
        DataPacket packet(raw_ptr->sync, raw_ptr->id, std::move(data),
                          raw_crc8);
        if (!packet.validate_crc()) {
            std::cout << "Invalid checksum\n";
            return std::nullopt;
        }

        return packet;
    }


    uint8_t DataPacket::calculate_crc8() const
    {
        // Using CRC8 Opensafety (0x2F)
        constexpr uint8_t CRC8_TABLE[256] = {
            0x00, 0x2F, 0x5E, 0x71, 0xBC, 0x93, 0xE2, 0xCD, 0x57, 0x78, 0x09, 0x26, 0xEB,
            0xC4, 0xB5, 0x9A, 0xAE, 0x81, 0xF0, 0xDF, 0x12, 0x3D, 0x4C, 0x63, 0xF9, 0xD6,
            0xA7, 0x88, 0x45, 0x6A, 0x1B, 0x34, 0x73, 0x5C, 0x2D, 0x02, 0xCF, 0xE0, 0x91,
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            0x15, 0x8F, 0xA0, 0xD1, 0xFE, 0x33, 0x1C, 0x6D, 0x42};
        constexpr uint8_t CRC_INIT {0x00};

        uint8_t crc8 {CRC_INIT};
        crc8 = CRC8_TABLE[crc8 ^ sync_];
        crc8 = CRC8_TABLE[crc8 ^ static_cast<uint8_t>(id_)];

        crc8 = CRC8_TABLE[crc8 ^ static_cast<uint8_t>(data_.size())];

        // Loop over every byte in data_
        for (uint8_t i : data_) {
            crc8 = CRC8_TABLE[crc8 ^ i];
        }

        return crc8;
    }


    bool DataPacket::validate_crc() const
    {
        uint8_t computed_crc8 = calculate_crc8();
        return computed_crc8 == crc8_;
    }


} // namespace uart